#include "ssd1306.h"
#include <string.h>

static I2C_HandleTypeDef *oled_i2c;
static uint8_t SSD1306_Buffer[SSD1306_WIDTH * SSD1306_HEIGHT / 8];
static uint8_t currentX = 0, currentY = 0;

static const uint8_t Font5x7[][5] = {
    {0x00,0x00,0x00,0x00,0x00}, // Space
    {0x00,0x00,0x5F,0x00,0x00}, // !
    {0x00,0x07,0x00,0x07,0x00}, // "
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    {0x61,0x51,0x49,0x45,0x43}  // Z
};

static void WriteCmd(uint8_t cmd) {
    HAL_I2C_Mem_Write(oled_i2c, SSD1306_I2C_ADDR, 0x00, 1, &cmd, 1, 10);
}

void SSD1306_Init(I2C_HandleTypeDef *hi2c) {
    oled_i2c = hi2c;
    HAL_Delay(50);
    WriteCmd(0xAE);
    WriteCmd(0x20); WriteCmd(0x00);
    WriteCmd(0xB0);
    WriteCmd(0xC8);
    WriteCmd(0x00); WriteCmd(0x10);
    WriteCmd(0x40);
    WriteCmd(0x81); WriteCmd(0x7F);
    WriteCmd(0xA1);
    WriteCmd(0xA6);
    WriteCmd(0xA8); WriteCmd(0x3F);
    WriteCmd(0xA4);
    WriteCmd(0xD3); WriteCmd(0x00);
    WriteCmd(0xD5); WriteCmd(0x80);
    WriteCmd(0xD9); WriteCmd(0xF1);
    WriteCmd(0xDA); WriteCmd(0x12);
    WriteCmd(0xDB); WriteCmd(0x40);
    WriteCmd(0x8D); WriteCmd(0x14);
    WriteCmd(0xAF);
    SSD1306_Clear();
    SSD1306_UpdateScreen();
}

void SSD1306_Clear(void) {
    memset(SSD1306_Buffer, 0, sizeof(SSD1306_Buffer));
}

void SSD1306_UpdateScreen(void) {
    for (uint8_t i = 0; i < 8; i++) {
        WriteCmd(0xB0 + i);
        WriteCmd(0x00);
        WriteCmd(0x10);
        HAL_I2C_Mem_Write(oled_i2c, SSD1306_I2C_ADDR, 0x40, 1, &SSD1306_Buffer[SSD1306_WIDTH * i], SSD1306_WIDTH, 100);
    }
}

void SSD1306_GotoXY(uint8_t x, uint8_t y) {
    currentX = x;
    currentY = y;
}

void SSD1306_Puts(char* str) {
    while (*str) {
        char ch = *str;
        if (ch >= 'a' && ch <= 'z') ch -= 32;
        if (ch >= 32 && ch <= 'Z') {
            const uint8_t *glyph = Font5x7[ch - 32];
            for (uint8_t i = 0; i < 5; i++) {
                if (currentX < SSD1306_WIDTH) {
                    SSD1306_Buffer[currentX + (currentY * SSD1306_WIDTH)] = glyph[i];
                    currentX++;
                }
            }
            if (currentX < SSD1306_WIDTH) {
                SSD1306_Buffer[currentX + (currentY * SSD1306_WIDTH)] = 0x00;
                currentX++;
            }
        }
        str++;
    }
}
